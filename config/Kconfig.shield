## config/Kconfig.shield
```kconfig
config SHIELD_KLEIN_LEFT
    def_bool $(shields_list_contains,klein_left)

config SHIELD_KLEIN_RIGHT
    def_bool $(shields_list_contains,klein_right)  
```

## config/boards/shields/klein/Kconfig.defconfig
```kconfig
if SHIELD_KLEIN_RIGHT

config ZMK_KEYBOARD_NAME
    default "klein"

config ZMK_SPLIT_ROLE_CENTRAL
    default y

endif

if SHIELD_KLEIN_LEFT || SHIELD_KLEIN_RIGHT

config ZMK_SPLIT
    default y

endif
```

## config/west.yml
```yaml
manifest:
  remotes:
    - name: zmkfirmware
      url-base: https://github.com/zmkfirmware
    - name: infused-kim
      url-base: https://github.com/infused-kim
  projects:
    - name: zmk
      remote: infused-kim
      revision: my-changes/split-encoder
      import: app/west.yml
  self:
    path: config
```
